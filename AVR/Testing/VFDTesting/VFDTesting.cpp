#include "config.h"
#include "Noritake_VFD_GUU100.h"
#include "font20x32_digits.h"
#include "font8x8.h"
#include <util/delay.h>

#include <avr/interrupt.h>

static Noritake_VFD_GUU100 vfd;
volatile uint8_t brightness = 100;
bool adcFlag = false;
int adc = 0;
int adc_old = 0;

static const uint8_t PROGMEM img[] = { 
	

0x00, 0x01, 0x01, 0x03, 0xFF, 0x07, 0x1F, 0x3E, 0xFC, 0xF8, 0xE0, 0xC0,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 0x00,
0x00, 0x00, 0x20, 0x20, 0x3F, 0x20, 0x20, 0x20, 0x00, 0x01, 0x03, 0x0F,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 0x00,
0x00, 0x00, 0x00, 0x00, 0x00, 0x00, 0x00, 0x80, 0x80, 0xC0, 0xC0, 0xE0,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 0x00,
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0x00, 0x07, 0x3F, 0x3F, 0x3F, 0x7F, 0x7F, 0x7E, 0x7E, 0x7C, 0x7C, 0x7C,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 0x00,


};

int main()
{
	DDRB = 0x03; // B0 as output
	
	//ADC prescaler to 128 - 125kHz
	ADCSRA |= (1 << ADPS2) | (1 << ADPS1) | (1 << ADPS0);
	
	//set adc reference to AVCC, left adjust adc
	ADMUX |= (1 << REFS0) | (1 << ADLAR);	
	
	//no MUX values need to be changed for ADC0
	
	//enable ADC, enable ADC interrupt
	ADCSRA |= (1 << ADEN) | (1 << ADIE) | (1 << ADATE);
	
	sei(); // enable global interrupts
	
	ADCSRA |= (1 << ADSC); // start ADC
	
	//timer stuff
	TCCR1B |= (1 << CS10) | (1 << CS11);
	
	_delay_ms(500); // Wait for power up
	vfd.reset();
	vfd.init();

	unsigned max = NORITAKE_VERTICAL == 1 ? 99: 9999;
	uint8_t digits = NORITAKE_VERTICAL == 1? 2: 4;

	vfd.clearScreen();
	//vfd.setFont(font8x8, 20, 32);
	//vfd.fontGutter = 4;
	vfd.drawImage(img, 0,0,128,64);
	while(1)
	{
		//vfd.home();
		//vfd.print(brightness, digits - 1, '0');
		//vfd.crlf();
		//vfd.print(TCNT1, digits, '0');
		_delay_ms(50);
	}
}

ISR(ADC_vect)
{
	if ( ADCH <= 200 )
	{
		PORTB = 0x00;
		if (TCNT1 > 50000)
		{
			TCCR1B = 0x00;
			TCNT1 = 0;
		}
	}
	else if (ADCH > 200 && ADCH <= 220)
	{
		PORTB = 0x01;
		if (TCNT1 > 15000)
		{
			if (brightness >= 22) 
			{
				brightness -= 13;
				vfd.setScreenBrightness(brightness);
			}
			TCCR1B = 0x00;
			TCNT1 = 0;
		}
		else
		{
			if ((TCCR1B & CS10) != 1) TCCR1B |= (1 << CS10) | (1 << CS11);
		}
	}
	else if (ADCH > 220 && ADCH < 235)
	{
		PORTB = 0x02;
		if (TCNT1 > 15000)
		{
			if (brightness < 88) 
			{
				brightness += 13;
				vfd.setScreenBrightness(brightness);
			}
			TCCR1B = 0x00;
			TCNT1 = 0;
		}
		else
		{
			if ((TCCR1B & CS10) != 1) TCCR1B |= (1 << CS10) | (1 << CS11);
		}
	}
	else
		PORTB = 0x03;
}