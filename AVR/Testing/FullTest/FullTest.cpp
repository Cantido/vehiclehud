/*
 * FullTest.cpp
 *
 * Created: 8/18/2013 6:09:05 PM
 *  Author: Aaron
 */ 

#include "config.h"
#include "Noritake_VFD_GUU100.h"
#include "lcd.h"

#include <avr/io.h>
#include <avr/interrupt.h>
#include <util/delay.h>
#include <avr/pgmspace.h>
#include <stdlib.h>

#define STRING_LENGTH 28
#define LCD_MAX 20

static Noritake_VFD_GUU100 vfd;		//VFD object
volatile uint8_t brightness = 100;	//VFD brightness

char buffer[10];		//LCD buffer
bool update = true;		//LCD update flag

//Missouri S&T image
static const uint8_t PROGMEM img[] = {
	
	0x00, 0x01, 0x01, 0x03, 0xFF, 0x07, 0x1F, 0x3E, 0xFC, 0xF8, 0xE0, 0xC0,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 0x00,
	0x00, 0x00, 0x20, 0x20, 0x3F, 0x20, 0x20, 0x20, 0x00, 0x01, 0x03, 0x0F,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 0x00,
	0x00, 0x00, 0x00, 0x00, 0x00, 0x00, 0x00, 0x80, 0x80, 0xC0, 0xC0, 0xE0,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 0x00,
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	0x00, 0x07, 0x3F, 0x3F, 0x3F, 0x7F, 0x7F, 0x7E, 0x7E, 0x7C, 0x7C, 0x7C,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 0x00,
};

int main(void)
{
	DDRB = 0x03; // B0 as output
	
	/*  ADC Initialization */
	ADCSRA |= (1 << ADPS2) | (1 << ADPS1) | (1 << ADPS0); //ADC prescaler to 128 - 125kHz	
	ADMUX |= (1 << REFS0) | (1 << ADLAR); //set adc reference to AVCC, left adjust adc	
	//no MUX values need to be changed for ADC0	
	ADCSRA |= (1 << ADEN) | (1 << ADIE) | (1 << ADATE); //enable ADC, enable ADC interrupt
	
	sei(); // enable global interrupts
	
	ADCSRA |= (1 << ADSC); // start ADC
	
	//timer stuff
	TCCR1B |= (1 << CS10) | (1 << CS11);
	
	_delay_ms(500); // Wait for power up
	
	//initialize VFD
	vfd.reset();
	vfd.init();
	vfd.clearScreen();
	
	//draw image
	vfd.drawImage(img, 0,0,128,64);
	
	lcd_init(LCD_DISP_ON); /* initialize lcd, display on, cursor on */
	/* for more options for */
	/* lcd_init(), view lcd.h file */
	
	lcd_home();
	lcd_puts("Brightness: ");
	lcd_gotoxy(0, 2);
	lcd_puts("ADC: ");
	
    while(1)
    {
		if (update)
		{
			itoa(brightness, buffer, 10);
			lcd_gotoxy(12, 0);
			lcd_puts("   ");
			lcd_gotoxy(12, 0);
			lcd_puts(buffer);        /* type something random */
			lcd_gotoxy(5,2);          /* go to 2nd row 1st col */
			lcd_puts("   ");
			lcd_gotoxy(5,2);
			itoa(ADCH, buffer, 10);
			lcd_puts(buffer);        /* type something random */
			update = false;
		}
        _delay_ms(50);
    }
}

ISR(ADC_vect)
{
	if ( ADCH <= 200 )
	{
		if (TCNT1 > 50000)
		{
			TCCR1B = 0x00;
			TCNT1 = 0;
		}
	}
	else if (ADCH > 200 && ADCH <= 220)
	{
		if (TCNT1 > 15000)
		{
			if (brightness >= 22)
			{
				brightness -= 13;
				vfd.setScreenBrightness(brightness);
				update = true;			
			}
			TCCR1B = 0x00;
			TCNT1 = 0;
		}
		else
		{
			if ((TCCR1B & CS10) != 1) TCCR1B |= (1 << CS10) | (1 << CS11);
		}
	}
	else if (ADCH > 220 && ADCH < 235)
	{
		if (TCNT1 > 15000)
		{
			if (brightness < 88)
			{
				brightness += 13;
				vfd.setScreenBrightness(brightness);
				update = true;
			}
			TCCR1B = 0x00;
			TCNT1 = 0;
		}
		else
		{
			if ((TCCR1B & CS10) != 1) TCCR1B |= (1 << CS10) | (1 << CS11);
		}
	}
}